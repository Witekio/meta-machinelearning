## conf/layer.conf
```bitbake
# We have a conf and classes directory, add to BBPATH
BBPATH .= ":${LAYERDIR}"

# We have recipes-* directories, add to BBFILES
BBFILES += "${LAYERDIR}/recipes-*/*/*.bb \
	${LAYERDIR}/recipes-*/*/*.bbappend"

BBFILE_COLLECTIONS += "machinelearning"
BBFILE_PATTERN_machinelearning = "^${LAYERDIR}/"
BBFILE_PRIORITY_machinelearning = "8"

PREFERRED_VERSION_tensorflow-lite ?= "1.14%"
PREFERRED_VERSION_flatbuffers ?= "1.11.0%"
PREFERRED_VERSION_libeigen ?= "git%"

BBFILES += "${@' '.join('${LAYERDIR}/%s/recipes*/*/*.%s' % (layer, ext) \
               for layer in '${BBFILE_COLLECTIONS}'.split() for ext in ['bb', 'bbappend'])}"
```
